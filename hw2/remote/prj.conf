## CMakeLists.txt
```
# Copyright (c) 2024 Nordic Semiconductor ASA
# SPDX-License-Identifier: Apache-2.0

cmake_minimum_required(VERSION 3.20.0)
find_package(Zephyr REQUIRED HINTS $ENV{ZEPHYR_BASE})

project(remote)
target_sources(app PRIVATE ./src/main.c)
```

## prj.conf
```kconfig
# no additional configuration is required
CONFIG_PRINTK=y
CONFIG_LOG=y
```

## src/main.c
```c
/*
 * Copyright (c) 2012-2014 Wind River Systems, Inc.
 *
 * SPDX-License-Identifier: Apache-2.0
 */

#include <stdio.h>


int main(void)
{
	printf("Blabla from %s\n", CONFIG_BOARD_TARGET);

	return 0;
}
```
