## Kconfig
```
menu "Workshop"
    config MY_MESSAGE
    string "Custom String"
    default "Hello World Custom"
endmenu
menu "Zephyr Kernal"
    source "Kconfig.zephyr"
endmenu
```

## prj.conf
```kconfig
# nothing here
CONFIG_LOG=y
CONFIG_LOG_BACKEND_UART=y
CONFIG_MY_MESSAGE="Nordic's the best" 
```

## src/main.c
```c
/*
 * Copyright (c) 2012-2014 Wind River Systems, Inc.
 *
 * SPDX-License-Identifier: Apache-2.0
 */

#include <stdio.h>
#include <zephyr/logging/log.h>

LOG_MODULE_REGISTER(main,LOG_LEVEL_DBG);


int main(void)
{
	//LOG_INF("Hello World! %s", CONFIG_BOARD_TARGET);
	LOG_INF("%s %s",CONFIG_MY_MESSAGE,CONFIG_BOARD_TARGET);
	//printf("Hello World! %s\n", CONFIG_BOARD_TARGET);

	return 0;
}
```
