## prj.conf
```kconfig
# no additional configuration is required
CONFIG_PRINTK=y
```

## src/main.c
```c
/*
 * Copyright (c) 2012-2014 Wind River Systems, Inc.
 *
 * SPDX-License-Identifier: Apache-2.0
 */

#include <stdio.h>


int main(void)
{
	printf("Hello from %s\n", CONFIG_BOARD_TARGET);

	return 0;
}
```
